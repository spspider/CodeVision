0x00   PINF
0x01   PINE
0x02   DDRE
0x03   PORTE
0x04   ADCL
0x05   ADCH
0x06   ADCSR
0x07   ADMUX
0x08   ACSR
0x09   UBRR
0x0A   UCR
0x0B   USR
0x0C   UDR
0x0D   SPCR
0x0E   SPSR
0x0F   SPDR
0x10   PIND
0x11   DDRD
0x12   PORTD
0x15   PORTC
0x16   PINB
0x17   DDRB
0x18   PORTB
0x19   PINA
0x1A   DDRA
0x1B   PORTA
0x1C   EECR
0x1D   EEDR
0x1E   EEARL
0x1F   EEARH
0x21   WDTCR
0x23   OCR2
0x24   TCNT2
0x25   TCCR2
0x26   ICR1L
0x27   ICR1H
0x28   OCR1BL
0x29   OCR1BH
0x2A   OCR1AL
0x2B   OCR1AH
0x2C   TCNT1L
0x2D   TCNT1H
0x2E   TCCR1B
0x2F   TCCR1A
0x30   ASSR
0x31   OCR0
0x32   TCNT0
0x33   TCCR0
0x34   MCUSR
0x35   MCUCR
0x36   TIFR
0x37   TIMSK
0x38   EIFR
0x39   EIMSK
0x3A   EICR
0x3B   RAMPZ
0x3C   XDIV
0x3D   SPL
0x3E   SPH
0x3F   SREG
